## drivers/net/wireless/broadcom/wl/Kconfig
```kconfig
config WL
	tristate "Broadcom 802.11a/b/g/n hybrid device driver"
	depends on PCI && CFG80211
	select MAC80211
	select LIB80211
	select LIB80211_CRYPT_TKIP
	---help---
	  This module adds support for Broadcom 802.11a/b/g/n hybrid Networking Device Driver.

	  This driver can be built as a module (recommended) that will be called "wl".
	  If unsure, say M.
```

## drivers/staging/gslx680/Kconfig
```kconfig
config GSLX680
	tristate "GSLx680 I2C Touchscreen Interface"
	help
	  GSLx680 needs a firmware to work in /lib/firmware/silead_ts.fw
	  GSLx680 needs to be loaded manually or during boot
	  defined gslx680_ts_acpi in /etc/modules or /etc/init.sh
```

## drivers/staging/r92su/Kconfig
```kconfig
config R92SU
	tristate "Realtek RTL8192SU/RTL8191SU/RTL8188SU USB Wireless Network Adapter"
	depends on USB && CFG80211
	select FW_LOADER
	help
	 This is the driver for Realtek RTL8192SU/RTL8191SU/RTL8188SU 802.11
	 USB wireless network adapters.

	 For more information, visit our wiki at:
	 <http://linuxwireless.org/en/users/Drivers/rtl819x>

	 If you choose to build it as a module, it will be called r92su.

config R92SU_DEBUGFS
	bool "R92SU Debugfs Support"
	depends on R92SU && DEBUG_FS
	default n
	help
	 Export several driver and device internals to user space
	 via debugfs. Be be advised: writing random data in
	 "hw_iowrite" might damage the device.

	 Say N, unless you have a good reason.

config R92SU_TRACING
	bool "R92SU device access tracing"
        depends on R92SU
        depends on EVENT_TRACING
	default n
	help
	 Say Y here to trace all commands, including TX frames and IO
         accesses, sent to the device.

	 When tracing is not enabled, this option still has some
	 (though rather small) overhead.

	 If unsure, say Y so we can help you better when problems
	 occur.

config R92SU_WPC
	bool
	depends on R92SU && (INPUT = y || INPUT = R92SU)
	default y
```
